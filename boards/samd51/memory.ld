/**
 *
 *
 *
 */
MEMORY
{
  BOOTLOADER (rx) : ORIGIN = 0x00000000, LENGTH = 0x00008000
  FLASH (rx) : ORIGIN = 0x00000000 + 0x00008000, LENGTH = 0x100000 - 0x00008000
  RAM (rwx) : ORIGIN = 0x20000000, LENGTH = 0x00040000
}
